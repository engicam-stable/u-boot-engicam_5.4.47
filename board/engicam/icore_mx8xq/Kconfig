## board/engicam/icore_mx8xq/Kconfig
```kconfig
if TARGET_ICORE_MX8XQ

config SYS_BOARD
	default "icore_mx8xq"

config SYS_VENDOR
	default "engicam"

config SYS_CONFIG_NAME
	default "icore_mx8xq"

source "board/freescale/common/Kconfig"

endif
```
